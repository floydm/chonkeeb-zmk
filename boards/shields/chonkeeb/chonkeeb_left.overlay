/*
 * Copyright (c) 2024 Floyd Maloto
 *
 * SPDX-License-Identifier: MIT
 */

#include "chonkeeb.dtsi"

// Left half column GPIOs (columns 0-5)
&kscan0 {
    col-gpios
        = <&pro_micro 19 GPIO_ACTIVE_HIGH>  // Column 0
        , <&pro_micro 18 GPIO_ACTIVE_HIGH>  // Column 1
        , <&pro_micro 15 GPIO_ACTIVE_HIGH>  // Column 2
        , <&pro_micro 14 GPIO_ACTIVE_HIGH>  // Column 3
        , <&pro_micro 16 GPIO_ACTIVE_HIGH>  // Column 4
        , <&pro_micro 10 GPIO_ACTIVE_HIGH>; // Column 5
};

// Enable encoder for left half
&left_encoder {
    status = "okay";
};